## config/boards/shields/corne_v4_max/Kconfig.defconfig
```kconfig
if SHIELD_CORNE_V4_MAX_LEFT

    config ZMK_KEYBOARD_NAME
        default "CORNE-V4-MAX-L"

    config ZMK_SPLIT_BLE_ROLE_CENTRAL
        default y

endif

if SHIELD_CORNE_V4_MAX_RIGHT

    config ZMK_KEYBOARD_NAME
        default "CORNE-V4-MAX-R"

endif

if SHIELD_CORNE_V4_MAX_LEFT || SHIELD_CORNE_V4_MAX_RIGHT

    config ZMK_SPLIT
        default y
    config ZMK_KEYBOARD_NAME
        default "Corne V4 Max"

endif
```
