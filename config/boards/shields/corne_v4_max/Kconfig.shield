## config/boards/shields/corne_v4_max/Kconfig.shield
```kconfig
config SHIELD_CORNE_V4_MAX_LEFT
    def_bool $(shields_list_contains,corne_left)

config SHIELD_CORNE_V4_MAX_RIGHT
    def_bool $(shields_list_contains,corne_right)
```
